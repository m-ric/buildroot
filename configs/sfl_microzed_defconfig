## configs/sfl_microzed_defconfig
```kconfig
BR2_arm=y
BR2_cortex_a9=y
BR2_ARM_FPU_VFPV3=y
BR2_KERNEL_HEADERS_VERSION=y
BR2_DEFAULT_KERNEL_VERSION="3.8"
BR2_TOOLCHAIN_BUILDROOT_LARGEFILE=y
BR2_TOOLCHAIN_BUILDROOT_INET_RPC=y
BR2_TOOLCHAIN_BUILDROOT_WCHAR=y
BR2_PTHREAD_DEBUG=y
BR2_TOOLCHAIN_BUILDROOT_CXX=y
BR2_PACKAGE_HOST_GDB=y
BR2_ECLIPSE_REGISTER=y
BR2_ROOTFS_DEVICE_CREATION_DYNAMIC_UDEV=y
BR2_TARGET_GENERIC_ROOT_PASSWD="rub"
BR2_TARGET_GENERIC_GETTY_PORT="ttyPS0"
BR2_ROOTFS_OVERLAY="$(TOPDIR)/overlay"
BR2_ROOTFS_POST_BUILD_SCRIPT="$(TOPDIR)/board/avnet/microzed/post-build.sh"
BR2_LINUX_KERNEL=y
BR2_LINUX_KERNEL_CUSTOM_GIT=y
BR2_LINUX_KERNEL_CUSTOM_REPO_URL="http://www.github.com/Xilinx/linux-xlnx.git"
BR2_LINUX_KERNEL_CUSTOM_REPO_VERSION="xilinx-14.5-build-trd"
BR2_LINUX_KERNEL_PATCH="$(TOPDIR)/board/zynq/microzed/sdwrite.patch"
BR2_LINUX_KERNEL_DEFCONFIG="xilinx_zynq"
BR2_LINUX_KERNEL_UIMAGE_LOADADDR="0x108000"
BR2_LINUX_KERNEL_DTS_SUPPORT=y
BR2_LINUX_KERNEL_USE_CUSTOM_DTS=y
BR2_LINUX_KERNEL_CUSTOM_DTS_PATH="$(TOPDIR)/board/zynq/microzed/uzed.dts"
BR2_PACKAGE_BUSYBOX_SHOW_OTHERS=y
BR2_PACKAGE_LED_CONTROL=y
BR2_PACKAGE_GDB=y
BR2_PACKAGE_STRACE=y
BR2_PACKAGE_READLINE=y
BR2_PACKAGE_IFPLUGD=y
BR2_PACKAGE_OPENSSH=y
BR2_TARGET_ROOTFS_EXT2=y
BR2_TARGET_ROOTFS_EXT2_UBOOT=y
BR2_TARGET_ROOTFS_EXT2_LOADADDR="0x2000000"
BR2_TARGET_ROOTFS_EXT2_GZIP=y
BR2_TARGET_UBOOT=y
BR2_TARGET_UBOOT_BOARDNAME="zynq_microzed"
BR2_TARGET_UBOOT_CUSTOM_GIT=y
BR2_TARGET_UBOOT_CUSTOM_REPO_URL="https://github.com/vxmdesign/u-boot-xlnx.git"
BR2_TARGET_UBOOT_CUSTOM_REPO_VERSION="vxm-uboot-v2.3"
BR2_TARGET_UBOOT_CUSTOM_PATCH_DIR="$(TOPDIR)/board/zynq/microzed/"
BR2_TARGET_UBOOT_FORMAT_IMG=y
BR2_TARGET_UBOOT_SPL=y
BR2_TARGET_UBOOT_SPL_NAME="boot.bin"
```

## package/avnet/Config.in
```kconfig
menu "Zed boards"
	depends on BR2_arm

source "package/avnet/microzed/Config.in"

endmenu
```

## package/avnet/microzed/Config.in
```kconfig
menu "Microzed"
	depends on BR2_arm

source "package/avnet/microzed/led-control/Config.in"

endmenu
```

## package/avnet/microzed/led-control/Config.in
```kconfig
config BR2_PACKAGE_LED_CONTROL
	bool "led-control"
	depends on BR2_LINUX_KERNEL
	depends on BR2_arm
	help
	  Small utility to control microzed's onboard LEDs.
```
